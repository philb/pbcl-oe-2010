## conf/machine/cbnl-comexpress.conf
```bitbake
TARGET_ARCH = "i686"

include conf/machine/include/tune-atom.inc

MACHINE_FEATURES = "kernel26 screen keyboard pci usbhost ext2 ext3 x86 wifi \
                    acpi"

KERNEL_IMAGETYPE = "bzImage"

PREFERRED_PROVIDER_virtual/kernel ?= "linux"

GLIBC_ADDONS = "nptl"
GLIBC_EXTRA_OECONF = "--with-tls"
```
